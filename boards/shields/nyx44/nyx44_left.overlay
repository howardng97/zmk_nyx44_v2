/*
 * Copyright (c) 2022 The ZMK Contributors
 *
 * SPDX-License-Identifier: MIT
 */

#include "nyx44.dtsi"


&kscan {
    col-gpios 
           = <&pro_micro 18 GPIO_ACTIVE_HIGH>
           , <&pro_micro 15 GPIO_ACTIVE_HIGH>
           , <&pro_micro 14 GPIO_ACTIVE_HIGH>
           , <&pro_micro 16 GPIO_ACTIVE_HIGH>
           , <&pro_micro 10 GPIO_ACTIVE_HIGH>
           , <&pro_micro 9 GPIO_ACTIVE_HIGH>
           , <&pro_micro 8 GPIO_ACTIVE_HIGH>
           ;

};
