## boards/shields/nyx44/Kconfig.defconfig
```kconfig
# Copyright (c) 2022 The ZMK Contributors
# SPDX-License-Identifier: MIT

if SHIELD_NYX44_LEFT

config ZMK_KEYBOARD_NAME
    default "NYX44V2"

config ZMK_SPLIT_ROLE_CENTRAL
    default y

endif 

if SHIELD_NYX44_LEFT || SHIELD_NYX44_RIGHT

config ZMK_SPLIT
    default y

endif 
```

## boards/shields/nyx44/Kconfig.shield
```kconfig
# Copyright (c) 2022 The ZMK Contributors
# SPDX-License-Identifier: MIT

config SHIELD_NYX44_LEFT
    def_bool $(shields_list_contains,nyx44_left)

config SHIELD_NYX44_RIGHT
    def_bool $(shields_list_contains,nyx44_right)
```
